#ifdef __AVR__
  #include <avr/io.h>
  #include <avr/pgmspace.h>
#elif defined(ESP8266)
  #include <pgmspace.h>
#else
  #define PROGMEM
#endif

// Standard ASCII 5x7 font

static const unsigned char font[] PROGMEM = {
  0x00, 0x00, 0x00, 0x00, 0x00,
  0x3E, 0x5B, 0x4F, 0x5B, 0x3E,
  0x3E, 0x6B, 0x4F, 0x6B, 0x3E,
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  0x00, 0x00, 0x00, 0x00, 0x00  // #255 NBSP
};
void oled_GFX(int16_t w, int16_t h)
{
  //_width    = WIDTH;
  //_height   = HEIGHT;
  //rotation  = 0;
  cursor_y  = cursor_x    = 0;
  //textsize  = 1;

  //textcolor = textbgcolor = 0xFFFF;
  //wrap      = true;
  //_cp437    = false;
  gfxFont   = NULL;
}

// Draw a rectangle
void oled_drawRect(int16_t x, int16_t y, int16_t w, int16_t h, uint16_t color)
{
  drawFastHLine(x, y, w, color);
  drawFastHLine(x, y + h - 1, w, color);
  drawFastVLine(x, y, h, color);
  drawFastVLine(x + w - 1, y, h, color);
}

void oled_drawBitmap_flash(int16_t x, int16_t y,
                           const uint8_t *bitmap, int16_t w, int16_t h, uint16_t color) {

  int16_t i, j, byteWidth = (w + 7) / 8;
  uint8_t byte;

  for (j = 0; j < h; j++) {
    for (i = 0; i < w; i++) {
      if (i & 7) byte <<= 1;
      else      byte   = pgm_read_byte(bitmap + j * byteWidth + i / 8);
      //if (byte & 0x80) drawPixel(x + i, y + j, color);
      if (byte & 0x80) drawPixel(x + i, y + j);
    }
  }
}

// drawBitmap() variant for RAM-resident (not PROGMEM) bitmaps.
void oled_drawBitmap_ram(int16_t x, int16_t y,
                         uint8_t *bitmap, int16_t w, int16_t h, uint16_t color) {

  int16_t i, j, byteWidth = (w + 7) / 8;
  uint8_t byte;

  for (j = 0; j < h; j++) {
    for (i = 0; i < w; i++ ) {
      if (i & 7) byte <<= 1;
      else      byte   = bitmap[j * byteWidth + i / 8];
      //if (byte & 0x80) drawPixel(x + i, y + j, color);
      if (byte & 0x80) drawPixel(x + i, y + j);
    }
  }
}

void oled_setCursor(int16_t x, int16_t y) {
  cursor_x = x;
  cursor_y = y;
}

void oled_setFont(const GFXfont *f) {
  if (f) {         // Font struct pointer passed in?
    if (!gfxFont) { // And no current font struct?
      // Switching from classic to new font behavior.
      // Move cursor pos down 6 pixels so it's on baseline.
      cursor_y += 6;
    }
  } else if (gfxFont) { // NULL passed.  Current font struct defined?
    // Switching from new to classic font behavior.
    // Move cursor pos up 6 pixels so it's at top-left of char.
    cursor_y -= 6;
  }
  gfxFont = (GFXfont *)f;
}

size_t write(uint8_t c) {


  if (!gfxFont) { // 'Classic' built-in font

    if (c == '\n') {
      cursor_y += textsize * 8;
      cursor_x  = 0;
    } else if (c == '\r') {
      // skip em
    } else {
      if (wrap && ((cursor_x + textsize * 6) >= WIDTH)) { // Heading off edge?
        cursor_x  = 0;            // Reset x to zero
        cursor_y += textsize * 8; // Advance y one line
      }
      drawChar(cursor_x, cursor_y, c, textcolor, textbgcolor, textsize);
      cursor_x += textsize * 6;
    }

  } else { // Custom font

    if (c == '\n') {
      cursor_x  = 0;
      cursor_y += (int16_t)textsize *
                  (uint8_t)pgm_read_byte(&gfxFont->yAdvance);
    } else if (c != '\r') {
      uint8_t first = pgm_read_byte(&gfxFont->first);
      if ((c >= first) && (c <= (uint8_t)pgm_read_byte(&gfxFont->last))) {
        uint8_t   c2    = c - pgm_read_byte(&gfxFont->first);
        GFXglyph *glyph = &(((GFXglyph *)pgm_read_pointer(&gfxFont->glyph))[c2]);
        uint8_t   w     = pgm_read_byte(&glyph->width),
                  h     = pgm_read_byte(&glyph->height);
        if ((w > 0) && (h > 0)) { // Is there an associated bitmap?
          int16_t xo = (int8_t)pgm_read_byte(&glyph->xOffset); // sic
          if (wrap && ((cursor_x + textsize * (xo + w)) >= WIDTH)) {
            // Drawing character would go off right edge; wrap to new line
            cursor_x  = 0;
            cursor_y += (int16_t)textsize *
                        (uint8_t)pgm_read_byte(&gfxFont->yAdvance);
          }
          drawChar(cursor_x, cursor_y, c, textcolor, textbgcolor, textsize);
        }
        cursor_x += pgm_read_byte(&glyph->xAdvance) * (int16_t)textsize;
      }
    }

  }
#if ARDUINO >= 100
  return 1;
#endif
}

// Draw a character
void drawChar(int16_t x, int16_t y, unsigned char c,
              uint16_t color, uint16_t bg, uint8_t size) {

  if (!gfxFont) { // 'Classic' built-in font

    if ((x >= WIDTH)            || // Clip right
        (y >= HEIGHT)           || // Clip bottom
        ((x + 6 * size - 1) < 0) || // Clip left
        ((y + 8 * size - 1) < 0))   // Clip top
      return;

    //if(!_cp437 && (c >= 176)) c++; // Handle 'classic' charset behavior

    for (int8_t i = 0; i < 6; i++ ) {
      uint8_t line;
      if (i < 5) line = pgm_read_byte(font + (c * 5) + i);
      else      line = 0x0;
      for (int8_t j = 0; j < 8; j++, line >>= 1) {
        if (line & 0x1) {
          //if (size == 1) drawPixel(x + i, y + j, color);
          if (size == 1) drawPixel(x + i, y + j);
          //else          fillRect(x+(i*size), y+(j*size), size, size, color);
        } else if (bg != color) {
          //if (size == 1) drawPixel(x + i, y + j, bg);
          //if (size == 1) drawPixel(x + i, y + j);
          //else          fillRect(x+i*size, y+j*size, size, size, bg);
        }
      }
    }

  } else {
    // Custom font

    // Character is assumed previously filtered by write() to eliminate
    // newlines, returns, non-printable characters, etc.  Calling drawChar()
    // directly with 'bad' characters of font may cause mayhem!

    c -= pgm_read_byte(&gfxFont->first);
    GFXglyph *glyph  = &(((GFXglyph *)pgm_read_pointer(&gfxFont->glyph))[c]);
    uint8_t  *bitmap = (uint8_t *)pgm_read_pointer(&gfxFont->bitmap);

    uint16_t bo = pgm_read_word(&glyph->bitmapOffset);
    uint8_t  w  = pgm_read_byte(&glyph->width),
             h  = pgm_read_byte(&glyph->height),
             xa = pgm_read_byte(&glyph->xAdvance);
    int8_t   xo = pgm_read_byte(&glyph->xOffset),
             yo = pgm_read_byte(&glyph->yOffset);
    uint8_t  xx, yy, bits, bit = 0;
    int16_t  xo16, yo16;

    if (size > 1) {
      xo16 = xo;
      yo16 = yo;
    }

    // Todo: Add character clipping here

    // NOTE: THERE IS NO 'BACKGROUND' COLOR OPTION ON CUSTOM FONTS.
    // THIS IS ON PURPOSE AND BY DESIGN.  The background color feature
    // has typically been used with the 'classic' font to overwrite old
    // screen contents with new data.  This ONLY works because the
    // characters are a uniform size; it's not a sensible thing to do with
    // proportionally-spaced fonts with glyphs of varying sizes (and that
    // may overlap).  To replace previously-drawn text when using a custom
    // font, use the getTextBounds() function to determine the smallest
    // rectangle encompassing a string, erase the area with fillRect(),
    // then draw new text.  This WILL infortunately 'blink' the text, but
    // is unavoidable.  Drawing 'background' pixels will NOT fix this,
    // only creates a new set of problems.  Have an idea to work around
    // this (a canvas object type for MCUs that can afford the RAM and
    // displays supporting setAddrWindow() and pushColors()), but haven't
    // implemented this yet.

    for (yy = 0; yy < h; yy++) {
      for (xx = 0; xx < w; xx++) {
        if (!(bit++ & 7)) {
          bits = pgm_read_byte(&bitmap[bo++]);
        }
        if (bits & 0x80) {
          if (size == 1) {
            //drawPixel(x + xo + xx, y + yo + yy, color);
            drawPixel(x + xo + xx, y + yo + yy);
          } else {
            //fillRect(x+(xo16+xx)*size, y+(yo16+yy)*size, size, size, color);
          }
        }
        bits <<= 1;
      }
    }

  } // End classic vs custom font
}
/*void oled_setTextColor(uint16_t c) {
  // For 'transparent' background, we'll set the bg
  // to the same as fg instead of using a flag
  textcolor = textbgcolor = c;
}*/

size_t oled_print_f(const __FlashStringHelper *ifsh)
{
  PGM_P p = reinterpret_cast<PGM_P>(ifsh);
  size_t n = 0;
  while (1) {
    unsigned char c = pgm_read_byte(p++);
    if (c == 0) break;
    if (write(c)) n++;
    else break;
  }
  return n;
}

size_t oled_print_c_str(const String &s)
{
  return oled_print_str(s.c_str(), s.length());
}
size_t oled_print_str(const char *s, uint8_t size)
{
  //return write(s);
  while (size--) {
    write(*s++);
    //if (write(*s++)) n++;
    //else break;
  }
  //  uint16_t len=0;
  //  for(len=0
  //  return write(s.c_str(), s.length());
}

size_t oled_print_char(char c)
{
  return write(c);
}

size_t oled_print_byte(uint8_t n)
{
  oled_print_long((long) n);
}

size_t oled_print_int(int n)
{
  oled_print_long((long) n);
}
size_t oled_print_u_int(unsigned int n)
{
  oled_print_u_long((unsigned long) n);
}
size_t oled_print_u_long(unsigned long n)
{
  uint8_t base = 10;
  if (base == 0) {
    return write(n);
  } else if (base == 10) {
    /*if (n < 0) {
      int t = oled_print_char('-');
      n = -n;
      return printNumber(n, 10) + t;
    }*/
    return printNumber(n, 10);
  } else {
    return printNumber(n, base);
  }
}

size_t oled_print_long(long n)
{
  uint8_t base = 10;
  if (base == 0) {
    return write(n);
  } else if (base == 10) {
    if (n < 0) {
      int t = oled_print_char('-');
      n = -n;
      return printNumber(n, 10) + t;
    }
    return printNumber(n, 10);
  } else {
    return printNumber(n, base);
  }
}

size_t printNumber(unsigned long n, uint8_t base)
{
  char buf[8 * sizeof(long) + 1]; // Assumes 8-bit chars plus zero byte.
  char *str = &buf[sizeof(buf) - 1];

  *str = '\0';

  // prevent crash if called with base == 1
  if (base < 2) base = 10;
  uint8_t len=0;
  do {
    char c = n % base;
    n /= base;

    *--str = c < 10 ? c + '0' : c + 'A' - 10;
    len++;
  } while (n);

  return oled_print_str(str, len);
}

size_t oled_print_float(double number, uint8_t digits) 
{ 
  size_t n = 0;
  
  if (isnan(number)) return oled_print_f(F("nan"));
  if (isinf(number)) return oled_print_f(F("inf"));
  if (number > 4294967040.0) return oled_print_f (F("ovf"));  // constant determined empirically
  if (number <-4294967040.0) return oled_print_f (F("ovf"));  // constant determined empirically
  
  // Handle negative numbers
  if (number < 0.0)
  {
     n += oled_print_char('-');
     number = -number;
  }

  // Round correctly so that print(1.999, 2) prints as "2.00"
  double rounding = 0.5;
  for (uint8_t i=0; i<digits; ++i)
    rounding /= 10.0;
  
  number += rounding;

  // Extract the integer part of the number and print it
  unsigned long int_part = (unsigned long)number;
  double remainder = number - (double)int_part;
  n += oled_print_u_long(int_part);

  // Print the decimal point, but only if there are digits beyond
  if (digits > 0) {
    n += oled_print_char('.'); 
  }

  // Extract digits from the remainder one at a time
  while (digits-- > 0)
  {
    remainder *= 10.0;
    unsigned int toPrint = (unsigned int)(remainder);
    n += oled_print_u_int(toPrint);
    remainder -= toPrint; 
  } 
  
  return n;
}
